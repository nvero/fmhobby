/*******************************************************************************
?????                                                            
 P1???					 
*******************************************************************************/

#include<reg52.h>
#include <intrins.h>



/*****************************************************************************
  ????											
******************************************************************************/

void delayms(unsigned char ms)
{
	unsigned char i;
	while(ms--)
	{
	for(i = 0; i < 120; i++);
	}
}

/*****************************************************************************
*  ???													
******************************************************************************/
 main()
{
	unsigned char LED;
	LED = 0xfe;
	P1 = LED;
	while(1)
	{
	delayms(500);
//	LED = _crol_(LED,1);		//????1?,?????LED  ???????
	LED ^= 0xff;		//????1?,?????LED  ???????
	P1 = LED;
	delayms(100);
	LED ^= 0xff;		//????1?,?????LED  ???????
	P1 = LED;
	
	}
}
